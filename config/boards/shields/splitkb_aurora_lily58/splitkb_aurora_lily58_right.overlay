/ {
  sensors {
    compatible = "zmk,keymap-sensors";
    sensors = <&right_encoder>;
    triggers-per-rotation = <4>;
  };
};

right_encoder: encoder_right {
  compatible = "alps,ec11";
  a-gpios = <&gpio0 XX (GPIO_PULL_UP | GPIO_ACTIVE_HIGH)>;
  b-gpios = <&gpio0 YY (GPIO_PULL_UP | GPIO_ACTIVE_HIGH)>;
  status = "okay";
};
